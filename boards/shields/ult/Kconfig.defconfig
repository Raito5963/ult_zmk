## boards/shields/ult/Kconfig.defconfig
```kconfig
if SHIELD_ULT_LEFT || SHIELD_ULT_RIGHT

config ZMK_KEYBOARD_NAME
    default "Ult"

config ZMK_SPLIT
    default y

# 左側をセントラル（PCと接続する側）とする場合のデフォルト
if SHIELD_ULT_LEFT
config ZMK_SPLIT_ROLE_CENTRAL
    default y
endif

endif
```

## boards/shields/ult/Kconfig.shield
```kconfig
config SHIELD_ULT_LEFT
    def_bool $(shields_list_contains,ult_left)

config SHIELD_ULT_RIGHT
    def_bool $(shields_list_contains,ult_right)
```
